## boards/arm/npcx4m8f_evb/Kconfig.defconfig
```kconfig
# Copyright (c) 2023 Nuvoton Technology Corporation.
# SPDX-License-Identifier: Apache-2.0

if BOARD_NPCX4M8F_EVB

config BOARD
	default "npcx4m8f_evb"

endif # BOARD_NPCX4M8F_EVB

config SYS_CLOCK_TICKS_PER_SEC
	default 1000

config INPUT
	bool "Input configuration option"
	default y if KSCAN
```

## dts/bindings/power/npcx-hibernate-psl.yaml
```yaml
# Copyright (c) 2022 Nuvoton Technology Corporation.
# SPDX-License-Identifier: Apache-2.0

description: NPCX Power Switch Logic (PSL) control node for hibernating

compatible: "npcx-hibernate-psl"

include: [base.yaml, pinctrl-device.yaml]

properties:
  psl-driven-type:
    required: true
    type: string
    description: |
      PSL_OUT is driven by GPIO or FW Control bit
    enum:
      - "gpio-driven"
      - "fw-ctrl-driven"

  enable-gpios:
    type: phandle-array
    description: |
      GPIO to used to turn on/off the Core Domain power supply (VCC1) of NPCX
      embedded controller (EC)

  pinctrl-0:
    required: true

  pinctrl-names:
    required: true
```
