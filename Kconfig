## boards/arm/npcx4mnx_demo/Kconfig.defconfig
```kconfig
# Copyright (c) 2023 Nuvoton Technology Corporation.
# SPDX-License-Identifier: Apache-2.0

if BOARD_npcx4mnx_demo

config BOARD
	default "npcx4mnx_demo"

endif # BOARD_npcx4mnx_demo

config SYS_CLOCK_TICKS_PER_SEC
	default 1000

config KSCAN
	bool "KSCAN configuration option"
	default y 
```

## boards/nuvoton/npcx4mnx_demo/Kconfig.defconfig
```kconfig
# Copyright (c) 2023 Nuvoton Technology Corporation.
# SPDX-License-Identifier: Apache-2.0

config SYS_CLOCK_TICKS_PER_SEC
	default 1000

config INPUT
	bool "Input configuration option"
	default y if KSCAN
```

## boards/nuvoton/npcx4mnx_demo/Kconfig.npcx4mnx_demo
```kconfig
# Copyright (c) 2023 Nuvoton Technology Corporation.
# SPDX-License-Identifier: Apache-2.0

config BOARD_NPCX4MNX_DEMO
	select SOC_NPCX4M8F
```

## west.yml
```yaml
west:
  url: https://github.com/zephyrproject-rtos/west
  version: v0.7.2

manifest:
  remotes:
    - name: zephyrproject
      url-base: https://github.com/zephyrproject-rtos 
    - name: zephyrproject_nuvoton
      url-base: https://github.com/Nuvoton-EC-FAE

  projects:
    - name: zephyr
      path: zephyr
      remote: zephyrproject_nuvoton
      revision: npcx-v3.7-branch
      clone-depth: 1
      west-commands: scripts/west-commands.yml

    - name: cmsis
      remote: zephyrproject
      revision: 4b96cbb174678dcd3ca86e11e1f24bc5f8726da0
      path: modules/hal/cmsis
      groups:
        - hal
    - name: mbedtls
      remote: zephyrproject
      revision: 2f24831ee13d399ce019c4632b0bcd440a713f7c
      path: modules/crypto/mbedtls
      groups:
        - crypto
    - name: mcuboot
      remote: zephyrproject
      revision: fb2cf0ec3da3687b93f28e556ab682bdd4b85223
      path: bootloader/mcuboot
  self:
    path: ecfw_demo
```
