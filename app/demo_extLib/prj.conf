## CMakeLists.txt
```
# SPDX-License-Identifier: Apache-2.0

cmake_minimum_required(VERSION 3.20.0)

find_package(Zephyr REQUIRED HINTS $ENV{ZEPHYR_BASE})
project(demo_extLib)

# Add application source
target_sources(app PRIVATE src/main.c)

# Add libdemo include path
target_include_directories(app PRIVATE ${CMAKE_CURRENT_SOURCE_DIR}/include)

# Link libdemo prebuilt library based on Kconfig selection
if(CONFIG_LIBDEMO_BUILD_DEBUG)
  # Debug version (with symbols, can step into source)
  target_link_libraries(app PRIVATE ${CMAKE_CURRENT_SOURCE_DIR}/lib/libdemo_debug.a)
  message(STATUS "Using libdemo_debug.a (Debug build)")
else()
  # Release version (optimized, stripped, cannot step into source)
  target_link_libraries(app PRIVATE ${CMAKE_CURRENT_SOURCE_DIR}/lib/libdemo.a)
  message(STATUS "Using libdemo.a (Release build)")
endif()
```

## Kconfig
```
# SPDX-License-Identifier: Apache-2.0
#
# Kconfig for demo_extLib application

source "Kconfig.zephyr"

menu "Libdemo Demo Configuration"

choice LIBDEMO_BUILD_TYPE
	bool "Libdemo library build type"
	default LIBDEMO_BUILD_DEBUG
	help
	  Select which version of the libdemo library to use.
	  Debug version includes symbols for debugging (can step into source).
	  Release version is optimized and stripped (cannot step into source).

config LIBDEMO_BUILD_DEBUG
	bool "Debug build"
	help
	  Use libdemo_debug.a - includes debug symbols, allows stepping into library code.

config LIBDEMO_BUILD_RELEASE
	bool "Release build"
	help
	  Use libdemo.a - optimized and stripped, smaller size but cannot debug library internals.

endchoice

endmenu
```

## prj.conf
```kconfig
# SPDX-License-Identifier: Apache-2.0
#
# Configuration for demo_extLib
# Uses prebuilt libdemo library with configurable build type

# Basic configuration
CONFIG_SERIAL=y
CONFIG_PRINTK=y
CONFIG_LOG=y
CONFIG_LOG_BUFFER_SIZE=2048

# Libdemo build type selection
# Use CONFIG_LIBDEMO_BUILD_DEBUG=y for debug version (default)
# Use CONFIG_LIBDEMO_BUILD_RELEASE=y for release version
CONFIG_LIBDEMO_BUILD_DEBUG=y
# CONFIG_LIBDEMO_BUILD_RELEASE=y 

# Application-specific settings
CONFIG_MAIN_STACK_SIZE=2048
CONFIG_HEAP_MEM_POOL_SIZE=4096
```

## src/main.c
```c
/* Copyright (c) 2025 Your Organization
 * SPDX-License-Identifier: Apache-2.0
 */

#include <zephyr/kernel.h>
#include <zephyr/logging/log.h>
#include <libdemo/math_ops.h>

LOG_MODULE_REGISTER(demo_extLib, LOG_LEVEL_INF);

int main(void)
{
	LOG_INF("=================================");
	LOG_INF("libdemo Demo Application Starting");
	LOG_INF("=================================");

	/* Test data */
	int32_t numbers[] = {10, 20, 30, 40, 50};
	size_t count = ARRAY_SIZE(numbers);

	/* Display test data */
	LOG_INF("Test array: [10, 20, 30, 40, 50]");
	LOG_INF("Array size: %zu elements", count);
	LOG_INF("");

	/* Test: Sum */
	int32_t sum = libdemo_array_sum(numbers, count);
	LOG_INF("Sum: %d", sum);

	/* Test: Average */
	int32_t avg = libdemo_array_average(numbers, count);
	LOG_INF("Average: %d", avg);

	/* Test: Max */
	int32_t max = libdemo_array_max(numbers, count);
	LOG_INF("Max: %d", max);

	/* Test: Min */
	int32_t min = libdemo_array_min(numbers, count);
	LOG_INF("Min: %d", min);

	LOG_INF("");
	LOG_INF("=================================");
	LOG_INF("libdemo Demo Completed!");
	LOG_INF("=================================");

	/* Test with edge cases */
	LOG_INF("");
	LOG_INF("Edge case tests:");

	/* Empty array */
	int32_t empty_sum = libdemo_array_sum(NULL, 0);
	LOG_INF("Sum of NULL/empty array: %d (expected: 0)", empty_sum);

	/* Single element */
	int32_t single[] = {42};
	int32_t single_sum = libdemo_array_sum(single, 1);
	int32_t single_avg = libdemo_array_average(single, 1);
	LOG_INF("Single element [42] - Sum: %d, Avg: %d", single_sum, single_avg);

	/* Negative numbers */
	int32_t negatives[] = {-10, -20, -30};
	int32_t neg_sum = libdemo_array_sum(negatives, 3);
	int32_t neg_min = libdemo_array_min(negatives, 3);
	LOG_INF("Negative array [-10,-20,-30] - Sum: %d, Min: %d", neg_sum, neg_min);

	LOG_INF("");
	LOG_INF("All tests completed successfully!");

	return 0;
}
```
