## CMakeLists.txt
```
# SPDX-License-Identifier: Apache-2.0

cmake_minimum_required(VERSION 3.20.0)

find_package(Zephyr REQUIRED HINTS $ENV{ZEPHYR_BASE})
project(demo_coredump)

# Include the current source directory to search for header files
target_include_directories(app PRIVATE src)

target_sources(app PRIVATE src/main.c)
target_sources(app PRIVATE src/coredump_backend_other.c)
```

## prj.conf
```kconfig
CONFIG_SHELL=y
CONFIG_SHELL_PROMPT_UART="ecfw:~$ "
CONFIG_LOG=y
CONFIG_EC_LOG_LEVEL=4
CONFIG_DEBUG_THREAD_INFO=y

CONFIG_DEBUG_COREDUMP=y
CONFIG_DEBUG_COREDUMP_BACKEND_OTHER=y
CONFIG_MP_MAX_NUM_CPUS=1
CONFIG_DEBUG_COREDUMP_MEMORY_DUMP_MIN=y
CONFIG_DEBUG_COREDUMP_MEMORY_DUMP_LINKER_RAM=n
```

## src/main.c
```c
/*
 * Copyright (c) 2024 NUVOTON Inc.
 *
 * SPDX-License-Identifier: Apache-2.0
 */

#include <zephyr/kernel.h>
#include <zephyr/sys/printk.h>
#include <zephyr/debug/coredump.h>
#include <zephyr/shell/shell.h>
#include <zephyr/logging/log.h>
#include <coredump_other.h>


#define STACK_SIZE 1024
#define THREAD_PRIORITY 5

LOG_MODULE_REGISTER(demo_coredump, CONFIG_EC_LOG_LEVEL);


static struct k_thread thread1;
static struct k_thread thread2;
static K_THREAD_STACK_DEFINE(stack1, STACK_SIZE);
static K_THREAD_STACK_DEFINE(stack2, STACK_SIZE);

static int counter1 = 0;
static int counter2 = 0;
static int error;

void k_sys_fatal_error_handler(unsigned int reason, const z_arch_esf_t *pEsf)
{
    ARG_UNUSED(reason);
    ARG_UNUSED(pEsf);
    uint8_t *buf;
    LOG_ERR("Coredump triggered! Reason: %u\n", reason);
    // Simulate coredump output
    for (size_t i = 0; i < sizeof(*pEsf); i++) {
        LOG_ERR("%x", ((uint8_t *)pEsf)[i]);
        buf = (uint8_t *)pEsf;
    }

    if (pEsf) {
        printk("Exception Stack Frame:\n");
        printk("  R0:  0x%08x\n", pEsf->basic.r0);
        printk("  R1:  0x%08x\n", pEsf->basic.r1);
        printk("  R2:  0x%08x\n", pEsf->basic.r2);
        printk("  R3:  0x%08x\n", pEsf->basic.r3);
        printk("  R12: 0x%08x\n", pEsf->basic.r12);
        printk("  LR:  0x%08x\n", pEsf->basic.lr);
        printk("  PC:  0x%08x\n", pEsf->basic.pc);
        printk("  xPSR:0x%08x\n", pEsf->basic.xpsr);
    }
    // LOG_ERR("\n");
    uint8_t log_ptr = 0;
	size_t remaining = sizeof(*pEsf);
	size_t i = 0;

    while (remaining > 0) {
		if (hex2char(buf[i] >> 4, &log_buf[log_ptr]) < 0) {
			error = -EINVAL;
			break;
		}
		log_ptr++;

		if (hex2char(buf[i] & 0xf, &log_buf[log_ptr]) < 0) {
			error = -EINVAL;
			break;
		}
		log_ptr++;

		i++;
		remaining--;

		if ((log_ptr >= LOG_BUF_SZ) || (remaining == 0)) {
			log_buf[log_ptr] = '\0';
			LOG_ERR("%s", log_buf);
			log_ptr = 0;
		}
	}


    // Reset the error status to avoid halt
    reason = 0;
}

void thread1_entry(void *p1, void *p2, void *p3)
{
    while (1) {
        counter1++;
        printk("Thread 1: counter1 = %d\n", counter1);
        if (counter1 >= 20) {
            coredump_cmd(COREDUMP_CMD_CLEAR_ERROR, NULL);
            coredump_query(COREDUMP_QUERY_HAS_STORED_DUMP, NULL);
            k_oops();
        }
        k_sleep(K_MSEC(1000));
    }
}

void thread2_entry(void *p1, void *p2, void *p3)
{
    while (1) {
        counter2++;
        printk("Thread 2: counter2 = %d\n", counter2);
        if (counter2 >= 10) {
            coredump_cmd(COREDUMP_CMD_CLEAR_ERROR, NULL);
            coredump_query(COREDUMP_QUERY_HAS_STORED_DUMP, NULL);
            k_oops();
        }
        k_sleep(K_MSEC(500));
    }
}

void main(void)
{
    k_tid_t tid1 = k_thread_create(&thread1, stack1, STACK_SIZE, thread1_entry, NULL, NULL, NULL, THREAD_PRIORITY, 0, K_NO_WAIT);
    k_tid_t tid2 = k_thread_create(&thread2, stack2, STACK_SIZE, thread2_entry, NULL, NULL, NULL, THREAD_PRIORITY, 0, K_NO_WAIT);

    k_thread_join(tid1, K_FOREVER);
    k_thread_join(tid2, K_FOREVER);
}
```

## src/coredump_backend_other.c
```c
/*
 * Copyright Meta Platforms, Inc. and its affiliates.
 *
 * SPDX-License-Identifier: Apache-2.0
 */

#include <errno.h>
#include <zephyr/debug/coredump.h>
#include <zephyr/sys/printk.h>
#include <zephyr/logging/log.h>
#include <coredump_other.h>


LOG_MODULE_REGISTER(coredump, CONFIG_KERNEL_LOG_LEVEL);


static int error;
static bool is_valid;


// int hex2char(uint8_t x, char *c)
// {
// 	if (x <= 9) {
// 		*c = x + (char)'0';
// 	} else  if (x <= 15) {
// 		*c = x - 10 + (char)'a';
// 	} else {
// 		return -EINVAL;
// 	}

// 	return 0;
// }

static void coredump_empty_backend_start(void)
{
    /* Reset error, is_valid */
    error = 0;
    is_valid = false;
}

static void coredump_empty_backend_end(void)
{
    is_valid = true;
}

static void coredump_empty_backend_buffer_output(uint8_t *buf, size_t buflen)
{
    /* Output the coredump buffer through printk */
    uint8_t log_ptr = 0;
	size_t remaining = buflen;
	size_t i = 0;

    while (remaining > 0) {
		if (hex2char(buf[i] >> 4, &log_buf[log_ptr]) < 0) {
			error = -EINVAL;
			break;
		}
		log_ptr++;

		if (hex2char(buf[i] & 0xf, &log_buf[log_ptr]) < 0) {
			error = -EINVAL;
			break;
		}
		log_ptr++;

		i++;
		remaining--;

		if ((log_ptr >= LOG_BUF_SZ) || (remaining == 0)) {
			log_buf[log_ptr] = '\0';
			LOG_ERR("%s", log_buf);
			log_ptr = 0;
		}
	}

}

static int coredump_empty_backend_query(enum coredump_query_id query_id, void *arg)
{
    int ret;

    switch (query_id) {
    case COREDUMP_QUERY_GET_ERROR:
        ret = error;
        break;
    case COREDUMP_QUERY_HAS_STORED_DUMP:
        ret = is_valid ? 1 : 0;
        break;
    case COREDUMP_QUERY_GET_STORED_DUMP_SIZE:
        ret = 0;
        break;
    default:
        ret = -ENOTSUP;
        break;
    }

    return ret;
}

static int coredump_empty_backend_cmd(enum coredump_cmd_id cmd_id, void *arg)
{
    int ret;

    switch (cmd_id) {
    case COREDUMP_CMD_CLEAR_ERROR:
        error = 0;
        ret = 0;
        break;
    case COREDUMP_CMD_VERIFY_STORED_DUMP:
        ret = is_valid ? 1 : 0;
        break;
    case COREDUMP_CMD_INVALIDATE_STORED_DUMP:
        is_valid = false;
        ret = 0;
        break;
    case COREDUMP_CMD_ERASE_STORED_DUMP:
        is_valid = false;
        ret = 0;
        break;
    default:
        ret = -ENOTSUP;
        break;
    }

    return ret;
}

struct coredump_backend_api coredump_backend_other = {
    .start = coredump_empty_backend_start,
    .end = coredump_empty_backend_end,
    .buffer_output = coredump_empty_backend_buffer_output,
    .query = coredump_empty_backend_query,
    .cmd = coredump_empty_backend_cmd,
};
```

## src/coredump_other.h
```c
/* Length of buffer of printable size */
#define LOG_BUF_SZ		64

/* Length of buffer of printable size plus null character */
#define LOG_BUF_SZ_RAW		(LOG_BUF_SZ + 1)

/* Log Buffer */
static char log_buf[LOG_BUF_SZ_RAW];
```
