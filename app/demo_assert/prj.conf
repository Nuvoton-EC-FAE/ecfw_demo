## CMakeLists.txt
```
# SPDX-License-Identifier: Apache-2.0

cmake_minimum_required(VERSION 3.20.0)

find_package(Zephyr REQUIRED HINTS $ENV{ZEPHYR_BASE})
project(demo_assert)

target_sources(app PRIVATE src/main.c)
```

## prj.conf
```kconfig
# Enable assertions
CONFIG_ASSERT=y

# Set assertion level
CONFIG_ASSERT_LEVEL=1

# Enable logging for assertion messages
CONFIG_LOG=y
CONFIG_LOG_DEFAULT_LEVEL=4
CONFIG_LOG_BACKEND_UART=y
CONFIG_LOG_BACKEND_UART_OUTPUT_TEXT=y
CONFIG_LOG_MODE_IMMEDIATE=y


# Enable serial console for output
CONFIG_SERIAL=y
CONFIG_UART_CONSOLE=y
CONFIG_CONSOLE=y
CONFIG_UART_INTERRUPT_DRIVEN=y

# Enable shell for interactive logging
CONFIG_SHELL=y
CONFIG_SHELL_PROMPT_UART="zp:~$ "
```

## src/main.c
```c
#include <zephyr/kernel.h>
#include <zephyr/logging/log.h>
#include <zephyr/sys/printk.h>
#include <zephyr/sys/__assert.h>

LOG_MODULE_REGISTER(main, CONFIG_LOG_DEFAULT_LEVEL);


   void k_sys_fatal_error_handler(unsigned int reason, const z_arch_esf_t *esf)
   {
       LOG_ERR("Fatal error occurred! Error code: %d", reason);
       LOG_ERR("System will halt after a delay");

       k_busy_wait(100000);  

       // Option：system reboot
       // sys_reboot(SYS_REBOOT_COLD);

       // system idle
       for (;;) {
           k_cpu_idle();
       }
   }


void test_assertions(int value)
{
    __ASSERT(value > 0, "Value must be greater than 0, but got %d", value);

    if (value > 10) {
        __ASSERT_NO_MSG(value <= 10);
    }

    printk("Value is %d\n", value);
}

void main(void)
{
    printk("Assertion Example\n");
    LOG_INF("Starting Zephyr application with assertions enabled");

    test_assertions(5);   // This should pass
    // test_assertions(0);   // This should trigger an assertion failure
    test_assertions(15);  // This should also trigger an assertion failure
}
```
